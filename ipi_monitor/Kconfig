## ipi_monitor/Kconfig
```kconfig
# SPDX-License-Identifier: GPL-2.0-only

config IPI_MONITOR
	tristate "IPI Monitor Driver"
	depends on ARM64 && SMP
	default m
	help
	  This driver provides per-core health monitoring based on
	  IPI (Inter-Processor Interrupt) round-robin heartbeat.

	  A monitor kernel thread bound to a configurable CPU periodically
	  sends asynchronous IPIs to all other online CPUs. Each target CPU
	  increments its own heartbeat counter in the IPI callback. The
	  monitor thread detects stalled or unresponsive cores by checking
	  whether the counters keep advancing.

	  Say M to build this as a loadable kernel module.
```

## linux_subsys_time_sync/Kconfig
```kconfig
# SPDX-License-Identifier: GPL-2.0-only

config LINUX_SUBSYS_TIME_SYNC
	tristate "Linux Subsystem Time Sync Driver"
	depends on ARM64
	default m
	help
	  This driver generates a cross-core time synchronization anchor pair
	  (cntvct_snap, wall_snap) on the Linux (big core) side and broadcasts
	  it to shared memory for RT-Thread (small core) to read, so that log
	  timestamps from both OSes can be aligned to the same wall-clock.

	  The anchor pair is generated by sandwich-reading the ARM system
	  counter (CNTVCT_EL0) and CLOCK_REALTIME, and is written to a
	  configurable reserved-memory region using seqlock semantics.

	  Say M to build this as a loadable kernel module.
```

## per-core-thread_monitor/Kconfig
```kconfig
# SPDX-License-Identifier: GPL-2.0-only

config PER_CORE_HEARTBEAT
	tristate "Per-Core Thread Heartbeat Driver"
	depends on ARM64 && SMP
	default m
	help
	  This driver provides per-core scheduling liveness monitoring based on
	  bound kernel threads.

	  Each target CPU runs a bound heartbeat kernel thread that periodically
	  increments its own heartbeat counter. A monitor thread detects
	  soft-deadlocked (or scheduling-starved) cores by checking whether the
	  counters keep advancing.

	  This complements the IPI Monitor driver (ipi_monitor) to cover soft
	  lockups (L1) that IPI-based detection cannot distinguish.

	  Say M to build this as a loadable kernel module.
```
